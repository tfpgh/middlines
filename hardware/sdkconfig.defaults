## hardware/sdkconfig.defaults
```kconfig
# --- HTTPS-only TLS profile ---
# CONFIG_MBEDTLS_SSL_PROTO_DTLS is not set
# CONFIG_MBEDTLS_PSK_MODES is not set
# CONFIG_MBEDTLS_KEY_EXCHANGE_PSK is not set
# CONFIG_MBEDTLS_KEY_EXCHANGE_ECDHE_PSK is not set
# CONFIG_MBEDTLS_KEY_EXCHANGE_RSA_PSK is not set

# --- Ethernet (internal EMAC + external PHY example) ---
# Olimex ESP32-POE uses the internal ESP32 EMAC with a LAN8720 PHY
CONFIG_ETH_USE_ESP32_EMAC=y
CONFIG_ETH_PHY_INTERFACE_RMII=y
CONFIG_ETH_RMII_CLK_OUTPUT=y
CONFIG_ETH_RMII_CLK_OUT_GPIO=17

# --- Partition table for OTA ---
CONFIG_PARTITION_TABLE_TWO_OTA=y
CONFIG_BOOTLOADER_APP_ROLLBACK_ENABLE=y

# --- Flash size ---
CONFIG_ESPTOOLPY_FLASHSIZE_4MB=y

# --- Main task stack ---
CONFIG_ESP_MAIN_TASK_STACK_SIZE=4096

# --- BLE passive scan ---
CONFIG_BT_ENABLED=y
CONFIG_BTDM_CTRL_MODE_BLE_ONLY=y
CONFIG_BTDM_CTRL_MODE_BR_EDR_ONLY=n
CONFIG_BTDM_CTRL_MODE_BTDM=n
CONFIG_BT_BLUEDROID_ENABLED=n
CONFIG_BT_NIMBLE_ENABLED=y
CONFIG_BT_NIMBLE_ROLE_CENTRAL=n
CONFIG_BT_NIMBLE_ROLE_BROADCASTER=n
CONFIG_BT_NIMBLE_ROLE_OBSERVER=y
CONFIG_BT_NIMBLE_ROLE_PERIPHERAL=n
CONFIG_BT_NIMBLE_SECURITY_ENABLE=n

# --- NVS (for shell-based credential storage) ---
CONFIG_NVS_ENCRYPTION=n
CONFIG_LWIP_DHCP_GET_NTP_SRV=y

# --- Smaller release-oriented build ---
CONFIG_COMPILER_OPTIMIZATION_SIZE=y
CONFIG_LOG_DYNAMIC_LEVEL_CONTROL=y
CONFIG_LOG_DEFAULT_LEVEL_INFO=y
CONFIG_LOG_MAXIMUM_LEVEL_INFO=y
CONFIG_BOOTLOADER_LOG_LEVEL_INFO=y
CONFIG_ESP_GDBSTUB_ENABLED=n
```
